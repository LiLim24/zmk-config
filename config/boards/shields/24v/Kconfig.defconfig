## config/boards/shields/24v/Kconfig.defconfig
```kconfig
# Copyright (c) 2021 The ZMK Contributors
# SPDX-License-Identifier: MIT

if SHIELD_24v

config ZMK_KEYBOARD_NAME
    default "24v Keyboard"

endif
```

## config/boards/shields/24v/Kconfig.shield
```kconfig
# Copyright (c) 2021 The ZMK Contributors
# SPDX-License-Identifier: MIT

config SHIELD_24v
	def_bool $(shields_list_contains,24v)
```
